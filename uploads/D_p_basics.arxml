AUTOSAR XML (schema 00048)
package /SoftwareTypes/ComponentTypes
  application sw component type P_Basics
    provide port EchoInterface: nonqueued-sender-com-spec=Echo, provided-interface=EchoInterface
    behavior P_Basics_ib: data-type-mapping=Data_Type_Mappings
