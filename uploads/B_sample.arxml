AUTOSAR XML (schema 4.0)
package /ExamplePackage
  elements application-software-component-type=uuid=123e4567-e89b-12d3-a456-426614174001:
    application software component type SWC1: uuid=123e4567-e89b-12d3-a456-426614174000
    application software component type SWC2: uuid=123e4567-e89b-12d3-a456-426614174000
    composition sw component type Composition1: components=[SWC1, SWC3]
