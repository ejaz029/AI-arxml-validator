AUTOSAR XML
package /ExamplePackage
  component InvalidSWC1@!: reference-target=/ExamplePackage/NonExistentSWC
  component Invalid PDU Name: reference-target=/ExamplePackage/SWC3
  component DuplicateSWC: reference-target=/ExamplePackage/SWC1
